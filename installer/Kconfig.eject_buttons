## installer/Kconfig.leds
```kconfig
# LED parameter token types and defaults. Must be used within
# a "if MMU_HAS_LEDS" is cfg templates
#
# Responsible for setting:
#   MMU_HAS_LEDS
#   PARAM_ENABLED
#   PARAM_ANIMATION
#   PARAM_CHAIN_COUNT
#   PARAM_COLOR_ORDER
#   PARAM_EXIT_LEDS
#   PARAM_ENTRY_LEDS
#   PARAM_STATUS_LEDS
#   PARAM_LOGO_LEDS
#
#   PIN_NEOPIXEL (duplicate with pins)

config UNSELECT_MMU_HAS_LEDS
  def_bool n
config MMU_HAS_LEDS
  prompt "Has Leds?"
  depends on !UNSELECT_MMU_HAS_LEDS
  forceshow
  default n
  help
    Select if your MMU has LEDs.

if MMU_HAS_LEDS
  menu "Led config"

    config BOOL_ENABLE_LEDS
      bool "Enable LEDs?"
      default y
      help
        This allows you to install but turn off LED on startup.
    config PARAM_ENABLED
      string
      default "True" if BOOL_ENABLE_LEDS
      default "False"

    config BOOL_ENABLE_LEDS_ANIMATION
      bool "Enable animation?"
      default y
      help
        This allows you to turn off LED animations perhaps reducing the overhead
        on your main klipper CPU. Only disable if you have frequent TTC errors
        caused by overload (rarely necessary).
    config PARAM_ANIMATION
      string
      default "True" if BOOL_ENABLE_LEDS_ANIMATION
      default "False"

    config PARAM_CHAIN_COUNT
      int "Chain count     "
      default PARAM_NUM_GATES

    config PARAM_COLOR_ORDER
      string "Color order     "
      default "GRBW"

    config PARAM_EXIT_LEDS
      string

    config PARAM_EXIT_LEDS
      string "Exit leds       "
      generated_default "neopixel:$(UNIT_NAME)_gate{iter}_leds (1-%d)" "PARAM_NUM_GATES" "; " 0 PARAM_NUM_GATES if MMU_HAS_PER_GATE_MCU
      generated_default "neopixel:$(UNIT_NAME)_leds (1-%d)" "PARAM_NUM_GATES"

    config PARAM_ENTRY_LEDS
      string "Entry leds      "
      default ""

    config PARAM_STATUS_LEDS
      string "Status leds     "
      default ""

    config PARAM_LOGO_LEDS
      string "Logo leds       "
      default ""

    config PIN_NEOPIXEL
      prompt "Led Neopixel pin"
  endmenu
endif
```

## installer/Kconfig.warnings
```kconfig
#
# Highlight common config warnings as comments
# This is not exhaustive by any means.
# It is just designed as an aid...
#

config SHOW_WARNINGS
  bool
  depends on !MULTI_UNIT_ENTRY_POINT
  @repeat var=i min=1 max=20@
    default y if W$(i)
  @endrepeat@

config W1
    def_bool y if MMU_CUSTOM

config W2
    def_bool y if BOARD_TYPE_OTHER

config W3
    def_bool y if CHOICE_TOOLHEAD_TYPE_OTHER

config W4
    def_bool y if PARAM_GATE_HOMING_ENDSTOP = ""

config W5
    def_bool y if !INSTALL_CLIENT_MACROS

config W6
    def_bool y if MMU_HAS_LEDS && PIN_NEOPIXEL = ""

config W7
    def_bool y if MMU_HAS_FANS && PIN_FAN = ""

config W8
    def_bool y if MMU_HAS_ENCODER && PIN_ENCODER = ""

config W9
    def_bool y if MMU_HAS_SENSOR_SHARED_EXIT && PIN_SHARED_EXIT_SENSOR = ""

config W10
    def_bool y if MMU_HAS_SENSOR_BUFFER_TENSION && PIN_BUFFER_TENSION = ""

config W11
    def_bool y if MMU_HAS_SENSOR_BUFFER_COMPRESSION && PIN_BUFFER_COMPRESSION = ""

config W12
    def_bool y if MMU_HAS_SENSOR_BUFFER_PROPORTIONAL && PIN_BUFFER_ANALOG = ""

config W13
    def_bool y if MMU_HAS_HEATERS && PARAM_FILAMENT_HEATER = "" && PARAM_FILAMENT_HEATERS = ""

config W14
    def_bool y if MMU_HAS_ENVIRONMENT_SENSOR && PARAM_ENVIRONMENT_SENSOR = "" && PARAM_ENVIRONMENT_SENSORS = ""


if SHOW_WARNINGS
  comment "_"
  comment "_Config Warnings"

  comment "Custom MMU selected. You will need to carefully check configuration" if W1
  comment "Unknown MCU selected. You will need to configure all pins"           if W2
  comment "Toolhead type is 'other'. Are you sure it is not already defined?"   if W3
  comment "No gate homing endstop [Raw Settings/Endstops]"                      if W4
  comment "Caution. You opted to not install client macros [Software Options]"  if W5
  comment "Leds are enabled but no MCU pin defined"                             if W6
  comment "Fans are enabled but no MCU pin defined"                             if W7
  comment "Encoder is enabled but no MCU pin defined"                           if W8
  comment "Shared exit sensor is enabled but no MCU pin defined"                if W9
  comment "Buffer tension switch is enabled but no MCU pin defined"             if W10
  comment "Buffer compression switch is enabled but no MCU pin defined"         if W11
  comment "Buffer proportional feedback enabled but no analog MCU pin defined"  if W12
  comment "MMU heater is enabled but heater name(s) not defined"                if W13
  comment "MMU environment sensor is enabled but sensor name(s) not defined"    if W14

endif
```

## installer/boards/custom/Kconfig.emu_slb
```kconfig
config BOARD_TYPE_EMU_SLB_1_0
  bool "EMU SLB MCU"

if BOARD_TYPE_EMU_SLB_1_0
  config PARAM_BOARD_TYPE
    default "EMU SLB v1"

  choice CHOICE_MMU_CONNECTION_TYPE
    default CHOICE_MMU_CONNECTION_TYPE_SERIAL
  endchoice
  choice CHOICE_MMU_SERIAL_CONNECTION
    default $(mmu_serial_config,1,stm32)
  endchoice
  choice CHOICE_BUFFER_CONNECTION_TYPE
    default CHOICE_BUFFER_CONNECTION_TYPE_SERIAL
  endchoice
  choice CHOICE_BUFFER_SERIAL_CONNECTION
    default $(buffer_serial_config,1,stm32)
  endchoice

  config PIN_GEAR_UART 
    default "$(MCU_NAME):PA15"
  config PIN_GEAR_STEP
    default "$(MCU_NAME):PD0" 
  config PIN_GEAR_DIR
    default "$(MCU_NAME):PD1" 
  config PIN_GEAR_ENABLE
    default "!$(MCU_NAME):PD2" 
  config PIN_GEAR_DIAG
    default ""

  config PIN_ENTRY_SENSOR_0
    default "$(MCU_NAME):PB7" 

  config PIN_EXIT_SENSOR_0
    default "$(MCU_NAME):PB5"

  config PIN_EJECT_BUTTON_0
    default "^$(MCU_NAME):PB6"
  
  config PIN_NEOPIXEL
    default "$(MCU_NAME):PD3" 

  config PARAM_MISC_HARDWARE
    default "$(ml,\
[temperature_sensor $(UNIT_NAME)_environment]\n\
sensor_type: HTU21D\n\
i2c_mcu: $(MCU_NAME)\n\
i2c_software_scl_pin: $(MCU_NAME):PB10\n\
i2c_software_sda_pin: $(MCU_NAME):PB11\n\
htu21d_report_time: 10\n\
\n\
[heater_fan $(UNIT_NAME)_fan_left]\n\
pin: $(MCU_NAME):PC3\n\
shutdown_speed: 0\n\
heater: $(UNIT_NAME)_heater\n\
\n\
[heater_fan $(UNIT_NAME)_fan_right]\n\
pin: $(MCU_NAME):PC1\n\
shutdown_speed: 0\n\
heater: $(UNIT_NAME)_heater\n\
\n\
[heater_generic $(UNIT_NAME)_heater]\n\
gcode_id: $(UNIT_NAME)\n\
heater_pin: $(MCU_NAME):PB1\n\
max_power:1.0\n\
sensor_type: EPCOS 100K B57560G104F\n\
pullup_resistor: 1800\n\
sensor_pin: $(MCU_NAME):PA4\n\
control: watermark\n\
min_temp: 0\n\
max_temp: 70\n\
\n\
[verify_heater $(UNIT_NAME)_heater]\n\
max_error: 300\n\
check_gain_time: 600\n\
hysteresis: 10\n\
heating_gain: 1\n\
)"


# -------------------------------------
# Buffer
# -------------------------------------

  config PIN_BUFFER_TENSION
    default "!$(MCU_NAME):PB8"
  config PIN_BUFFER_COMPRESSION
    default "!$(MCU_NAME):PB9"

  if OPTION_PSF_BUFFER
    config PIN_BUFFER_ANALOG
      default "!$(MCU_NAME):PA3"
  endif

endif
```

## installer/mmu_types/Kconfig.emu
```kconfig
config MMU_TYPE_EMU_1_0
  bool "EMU  - Expandable Multi-material Unit"
  help
    EMU is a modular type-B MMU with each spool being contained in it's own
    (optionally heater) enclosure. It had many features and is an incredible
    choose for new builds. Highly recommended to use with a analog proportional
    sync-feedback buffer like PSF.
  select VIRTUAL_SELECTOR
  select MMU_HAS_ENVIRONMENT_SENSOR
  select MMU_HAS_PER_GATE_ENV_SENSORS
  select MMU_HAS_HEATER
  select MMU_HAS_PER_GATE_HEATERS
  select MMU_HAS_LEDS
  select MMU_HAS_EJECT_BUTTONS
  select MMU_HAS_SENSOR_ENTRY
  select BOOL_VARIABLE_ROTATION_DISTANCES
  select BOOL_REQUIRE_BOWDEN_MOVE
  select BOOL_FILAMENT_ALWAYS_GRIPPED
  select BOOL_ENABLE_SYNC_TO_EXTRUDER
  select BOOL_ENABLE_SYNC_FORM_TIP
  select BOOL_ENABLE_SYNC_PURGE
  imply  OPTION_PSF_BUFFER


# -------------------------------------
# Buffer option
# -------------------------------------

if MMU_TYPE_EMU_1_0
  config OPTION_PSF_BUFFER
    bool "PSF buffer"
    help
      Select if using the recommended PSF brand buffer connected to the bowden tube
      using its integrated mcu. Don't select if using a different buffer system (instead add
      under MMU additions)
    select MMU_HAS_SYNC_FEEDBACK_BUFFER
    select MMU_HAS_SENSOR_BUFFER_PROPORTIONAL

  choice CHOICE_BUFFER_SPRING_STATE
    default CHOICE_BUFFER_SPRING_STATE_TENSION
  endchoice

  config PARAM_BUFFER_RANGE
    default 16

  config PARAM_BUFFER_MAXRANGE
    default 16
endif


# -------------------------------------
# Defaults
# -------------------------------------

if MMU_TYPE_EMU_1_0

  source "Kconfig.num_gates"

  if SHOW_MMU_ADDITIONS_WITH_TYPE
    source "Kconfig.mmu_additions"
  endif

  source "Kconfig.capabilities"

  config PARAM_VENDOR
    default "EMU"
  config PARAM_VERSION
    default "1.0"  

  config PARAM_NUM_GATES
    default 5

  choice BOARD_TYPE
    default BOARD_TYPE_EMU_SLB_1_0
  endchoice

  config PARAM_GEAR_GEAR_RATIO
    default "1:1"
  config PARAM_GEAR_RUN_CURRENT
    default 0.9
  config PARAM_GEAR_HOLD_CURRENT
    default 0.1
  config PARAM_GEAR_MICROSTEPS
    default 4

  # "Leds" config
  config PARAM_COLOR_ORDER
    default "GRBW"

  # "Gates" config
  config PARAM_GATE_HOMING_MAX
    default 600
  config PARAM_GATE_PRELOAD_HOMING_MAX
    default 600
  config PARAM_GATE_PRELOAD_PARKING_DISTANCE
    default -1
  config PARAM_GATE_PARKING_DISTANCE
    default -1
  config PARAM_GATE_FINAL_EJECT_DISTANCE
    default 100

  config PARAM_ENVIRONMENT_SENSORS
    generated_default "$(UNIT_NAME)_env%d" "" PARAM_NUM_GATES

  config PARAM_FILAMENT_HEATERS
    generated_default "$(UNIT_NAME)_heater%d" "" PARAM_NUM_GATES

  comment "_"

endif 
```
